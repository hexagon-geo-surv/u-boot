## board/leica/beluga/Kconfig
```kconfig
if TARGET_IMX8MP_LEICA_BELUGA

config SYS_BOARD
	default "beluga"

config SYS_VENDOR
	default "leica"

config SYS_CONFIG_NAME
	default "beluga"

config IMX_CONFIG
	default "board/leica/beluga/imximage-8mp-lpddr4.cfg"

config LEICA_BOOTSCRIPT_EMMC_ADDR
	hex "Bootscript address in blocks on eMMC"
	default 0x32
	help
	  Address in blocks on eMMC bootscript is loaded from.

config LEICA_BOOTSCRIPT_EMMC_SIZE
	hex "Bootscript size in blocks on eMMC"
	default 0x8
	help
	  Size in blocks of bootscript on eMMC.

endif
```

## board/leica/crocodile/Kconfig
```kconfig
if TARGET_IMX8MM_LEICA_CROCODILE

config SYS_BOARD
	default "crocodile"

config SYS_VENDOR
	default "leica"

config SYS_CONFIG_NAME
	default "crocodile"

config IMX_CONFIG
	default "board/leica/crocodile/imximage-8mm-lpddr4.cfg"

config LEICA_BOOTSCRIPT_EMMC_ADDR
	hex "Bootscript address in blocks on eMMC"
	default 0x32
	help
	  Address in blocks on eMMC bootscript is loaded from.

config LEICA_BOOTSCRIPT_EMMC_SIZE
	hex "Bootscript size in blocks on eMMC"
	default 0x8
	help
	  Size in blocks of bootscript on eMMC.

endif
```

## configs/crocodile_fspi_defconfig
```kconfig
CONFIG_ARM=y
CONFIG_ARCH_IMX8M=y
CONFIG_SYS_TEXT_BASE=0x40200000
CONFIG_SYS_MALLOC_LEN=0x2000000
CONFIG_SYS_MALLOC_F_LEN=0x10000
CONFIG_SPL_GPIO=y
CONFIG_SPL_LIBCOMMON_SUPPORT=y
CONFIG_SPL_LIBGENERIC_SUPPORT=y
CONFIG_DM_GPIO=y
CONFIG_DEFAULT_DEVICE_TREE="crocodile-fspi"
CONFIG_SPL_TEXT_BASE=0x7E2000
CONFIG_TARGET_IMX8MM_LEICA_CROCODILE=y
CONFIG_IMX_CONFIG="board/leica/crocodile/imximage-8mm-lpddr4-fspi.cfg"
CONFIG_DEFAULT_FDT_FILE="crocodile.dtb"
CONFIG_SPL_NOR_SUPPORT=y
CONFIG_SPL_SERIAL=y
CONFIG_SPL_DRIVERS_MISC=y
CONFIG_SPL=y
CONFIG_DISTRO_DEFAULTS=y
CONFIG_SYS_LOAD_ADDR=0x40480000
CONFIG_FIT=y
CONFIG_FIT_EXTERNAL_OFFSET=0x3000
CONFIG_SPL_LOAD_FIT=y
# CONFIG_USE_SPL_FIT_GENERATOR is not set
CONFIG_OF_SYSTEM_SETUP=y
CONFIG_BOARD_LATE_INIT=y
CONFIG_SPL_BOARD_INIT=y
CONFIG_SPL_SEPARATE_BSS=y
CONFIG_SPL_I2C=y
CONFIG_SPL_POWER=y
CONFIG_SPL_WATCHDOG=y
CONFIG_SYS_PROMPT="u-boot=> "
# CONFIG_CMD_EXPORTENV is not set
# CONFIG_CMD_IMPORTENV is not set
# CONFIG_CMD_CRC32 is not set
CONFIG_CMD_CLK=y
CONFIG_CMD_FUSE=y
CONFIG_CMD_GPIO=y
CONFIG_CMD_I2C=y
CONFIG_CMD_MMC=y
CONFIG_CMD_CACHE=y
CONFIG_CMD_REGULATOR=y
CONFIG_CMD_EXT4_WRITE=y
CONFIG_OF_CONTROL=y
CONFIG_SPL_OF_CONTROL=y
CONFIG_ENV_OVERWRITE=y
CONFIG_ENV_IS_NOWHERE=y
CONFIG_SYS_RELOC_GD_ENV_ADDR=y
CONFIG_SYS_MMC_ENV_DEV=2
CONFIG_ENV_VARS_UBOOT_RUNTIME_CONFIG=y
CONFIG_SPL_DM=y
CONFIG_SPL_CLK_COMPOSITE_CCF=y
CONFIG_CLK_COMPOSITE_CCF=y
CONFIG_SPL_CLK_IMX8MM=y
CONFIG_CLK_IMX8MM=y
CONFIG_MXC_GPIO=y
CONFIG_DM_I2C=y
CONFIG_SUPPORT_EMMC_BOOT=y
CONFIG_MMC_IO_VOLTAGE=y
CONFIG_MMC_UHS_SUPPORT=y
CONFIG_MMC_HS400_ES_SUPPORT=y
CONFIG_MMC_HS400_SUPPORT=y
CONFIG_FSL_USDHC=y
CONFIG_PHYLIB=y
CONFIG_PHY_ATHEROS=y
CONFIG_DM_ETH=y
CONFIG_PHY_GIGE=y
CONFIG_FEC_MXC=y
CONFIG_MII=y
CONFIG_PINCTRL=y
CONFIG_SPL_PINCTRL=y
CONFIG_PINCTRL_IMX8M=y
CONFIG_DM_PMIC=y
CONFIG_SPL_DM_PMIC_PCA9450=y
CONFIG_DM_REGULATOR=y
CONFIG_DM_REGULATOR_FIXED=y
CONFIG_DM_REGULATOR_GPIO=y
CONFIG_MXC_UART=y
CONFIG_SYSRESET=y
CONFIG_SPL_SYSRESET=y
CONFIG_SYSRESET_PSCI=y
CONFIG_SYSRESET_WATCHDOG=y
CONFIG_DM_THERMAL=y
CONFIG_IMX_WATCHDOG=y
CONFIG_NET_RANDOM_ETHADDR=y
CONFIG_NXP_FSPI=y
CONFIG_SPI=y
CONFIG_DM_SPI=y
CONFIG_DM_SPI_FLASH=y
CONFIG_SPI_FLASH_STMICRO=y
CONFIG_SF_DEFAULT_BUS=3
CONFIG_SF_DEFAULT_CS=0
CONFIG_SF_DEFAULT_SPEED=80000000
CONFIG_SF_DEFAULT_MODE=0
```
